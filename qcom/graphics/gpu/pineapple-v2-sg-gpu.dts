/dts-v1/;
/plugin/;

#include <dt-bindings/clock/qcom,aop-qmp.h>
#include <dt-bindings/clock/qcom,gcc-pineapple.h>
#include <dt-bindings/clock/qcom,gpucc-pineapple.h>
#include <dt-bindings/clock/qcom,rpmh.h>
#include <dt-bindings/interconnect/qcom,pineapple.h>
#include <dt-bindings/interrupt-controller/arm-gic.h>
#include <dt-bindings/regulator/qcom,rpmh-regulator-levels.h>
#include <dt-bindings/interrupt-controller/arm-gic.h>

#include "pineapple-v2-gpu.dtsi"
#include "pineapple-v2-sg-gpu-pwrlevels.dtsi"

/ {
	model = "Qualcomm Technologies, Inc. Pineapple SG";
	compatible = "qcom,pineapple";
	qcom,msm-id = <682 0x20000>;
	qcom,board-id = <0 0>;
};

&msm_gpu {
	/delete-property/qcom,gpu-model;
	qcom,gpu-model = "Adreno33v2";
};
